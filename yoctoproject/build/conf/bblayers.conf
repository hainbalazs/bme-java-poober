## yoctoproject/build/conf/bblayers.conf
```bitbake
# POKY_BBLAYERS_CONF_VERSION is increased each time build/conf/bblayers.conf
# changes incompatibly
POKY_BBLAYERS_CONF_VERSION = "2"

BBPATH = "${TOPDIR}"
BBFILES ?= ""

BBLAYERS ?= " \
  /home/parallels/yoctoproject/poky/meta \
  /home/parallels/yoctoproject/poky/meta-poky \
  /home/parallels/yoctoproject/poky/meta-openembedded/meta-oe \
  /home/parallels/yoctoproject/poky/meta-openembedded/meta-networking \
  /home/parallels/yoctoproject/poky/meta-openembedded/meta-python \
  /home/parallels/yoctoproject/poky/meta-raspberrypi \
  /home/parallels/yoctoproject/poky/meta-drivergpio \
  "
```
